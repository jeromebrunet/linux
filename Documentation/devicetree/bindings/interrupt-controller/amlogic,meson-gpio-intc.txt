## Documentation/devicetree/bindings/interrupt-controller/amlogic,meson-gpio-intc.txt
```
Amlogic meson GPIO interrupt controller

Meson SoCs contains an interrupt controller which is able watch the SoC pads
and generate an interrupt on edges or level. The controller is essentially a
256 pads to 8 GIC interrupt multiplexer, with a filter block to select edge
or level and polarity. We don’t expose all 256 mux inputs because the
documentation shows that upper part is not mapped to any pad. The actual number
of interrupt exposed depends on the SoC.

Required properties:

- compatible : should be either
   "amlogic,meson8-gpio-intc” for meson8 SoCs (AML7826MX) or
   “amlogic,meson8b-gpio-intc” for meson8b SoCs (S805) or
   “amlogic,meson-gxbb-gpio-intc” for GXBB SoCs (S905)
   Generic compatible: "amlogic,meson-gpio-intc"
- interrupt-parent : a phandle to the GIC the interrupts are routed to.
   Usually this is provided at the root level of the device tree as it is
   common to most of the SoC.
- reg : Specifies base physical address and size of the registers.
- interrupt-controller : Identifies the node as an interrupt controller.
- #interrupt-cells : Specifies the number of cells needed to encode an
   interrupt source. The value must be 2.
- meson,upstream-interrupts: Array with the 8 upstream hwirq numbers. These
   are the hwirqs used on the parent interrupt controller.
- meson,num-input-mux: number of signal inputs available to the controller.
   This is also the number hwirq provided by the controller domain.

Example:

gpio_interrupt: interrupt-controller@9880 {
	compatible = "amlogic,meson-gxbb-gpio-intc",
		     "amlogic,meson-gpio-intc";
	reg = <0x0 0x9880 0x0 0x10>;
	interrupt-controller;
	#interrupt-cells = <2>;
	meson,upstream-interrupts = <64 65 66 67 68 69 70 71>;
	meson,num-input-mux = <133>;
};
```

## sound/soc/meson/Kconfig
```kconfig
menu "ASoC support for Amlogic platforms"
	depends on ARCH_MESON || COMPILE_TEST

config SND_MESON_AXG_CARD
	tristate "Amlogic AXG Sound Card Support"
	imply SND_MESON_AXG_MEMIF
	imply SND_MESON_AXG_TDM
	help
	 Select Y or M to add support for Audio subsystem of the Amlogic
	  AXG SoC family


config SND_MESON_AXG_MEMIF
	tristate "Amlogic AXG Audio Memory Interface Support"
	select REGMAP_MMIO
	imply COMMON_CLK_AXG_AUDIO
	imply RESET_MESON_AUDIO_ARB
	help
	  Select Y or M to add support for the audio memory interfaces
	  embedded in the Amlogic AXG SoC family

config SND_MESON_AXG_TDM
	tristate "Amlogic AXG TDM Input/Ouput Support"
	select REGMAP_MMIO
	imply COMMON_CLK_AXG_AUDIO
	help
	  Select Y or M to add support for TDM subsystem embedded in the
	  Amlogic AXG SoC family

endmenu
```
